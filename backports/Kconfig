## backports/Kconfig
```kconfig
config BACKPORT_INTEGRATE
	bool
	def_bool y

config BACKPORT_DIR
	string
	default "backports/"

config BACKPORT_VERSION
	string
	default "backports-20150903-0-g7b34ea21fb51"

config BACKPORT_KERNEL_VERSION
	string
	default "next-20150903-0-ga672f9246284"

config BACKPORT_KERNEL_NAME
	string
	default "Linux"

menuconfig BACKPORT_LINUX
	bool "Backport Linux next-20150903-0-ga672f9246284 (backports backports-20150903-0-g7b34ea21fb51)"
	default n
	---help---
	  Enabling this will let give you the opportunity to use features and
	  drivers backported from Linux next-20150903-0-ga672f9246284
	  on the kernel your are using. This is experimental and you should
	  say no unless you'd like to help test things or want to help debug
	  this should we run into any issues.

if BACKPORT_LINUX

source "$BACKPORT_DIR/Kconfig.versions"
source "$BACKPORT_DIR/Kconfig.sources"

endif # BACKPORT_LINUX
```

## backports/drivers/media/pci/netup_unidvb/Kconfig
```kconfig
config BACKPORT_DVB_NETUP_UNIDVB
	tristate "NetUP Universal DVB card support"
	depends on !DVB_NETUP_UNIDVB
	depends on DVB_CORE && BACKPORT_VIDEO_DEV && PCI && I2C && SPI_MASTER
    select BACKPORT_VIDEOBUF2_DVB
    select BACKPORT_VIDEOBUF2_VMALLOC
	select DVB_HORUS3A if BACKPORT_MEDIA_SUBDRV_AUTOSELECT
	select DVB_ASCOT2E if BACKPORT_MEDIA_SUBDRV_AUTOSELECT
	select DVB_LNBH25 if BACKPORT_MEDIA_SUBDRV_AUTOSELECT
	select DVB_CXD2841ER if BACKPORT_MEDIA_SUBDRV_AUTOSELECT
	---help---
	  Support for NetUP PCI express Universal DVB card.
```
